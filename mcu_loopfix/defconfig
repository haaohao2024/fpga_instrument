## mcu_loopfix/defconfig
```kconfig
CONFIG_CHIP="bl616"
CONFIG_BOARD="bl616dk"
CONFIG_RF=y
CONFIG_WIFI6=n
CONFIG_FATFS=n
CONFIG_FREERTOS=y
CONFIG_PSRAM=n
CONFIG_BFLB_LOG=n
CONFIG_SHELL=y
CONFIG_SHELL_THREAD_STACK_SIZE=2048
CONFIG_BLUETOOTH=y
CONFIG_BTBLECONTROLLER_LIB=ble1m2s1bredr1
CONFIG_BFLB_MTD=n
CONFIG_PARTITION=n
CONFIG_LITTLEFS=n
CONFIG_BT_OAD_SERVER=n

CONFIG_BT_STACK_CLI=n
CONFIG_BT_SETTINGS=n


CONFIG_BT_BREDR=y
CONFIG_BT_A2DP=y
CONFIG_BT_A2DP_SINK=y
CONFIG_BT_A2DP_SOURCE=n
CONFIG_BT_AVRCP=y
CONFIG_BT_HFP=n
CONFIG_BT_SPP=n

CONFIG_APP_BUILD_TYPE_DIRECT_BOOT_APP=y
CONFIG_APP_BUILD_TYPE_STD_APP=n
CONFIG_SKIP_COMBINE=y
CONFIG_BOARD_FLASH_LOW_SPEED=y
CONFIG_CHERRYUSB=y
CONFIG_CHERRYUSB_OSAL="freertos"
CONFIG_CHERRYUSB_DEVICE=y
CONFIG_CHERRYUSB_DEVICE_CDC_ACM=y
CONFIG_BSP_USB=y
CONFIG_BSP_CONSOLE_USB_CDC=y
```
